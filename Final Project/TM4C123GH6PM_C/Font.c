#include "Font.h"

/*******************************
Found fonts on 
http://jared.geek.nz/2014/jan/custom-fonts-for-microcontrollers
each byte is one column with msb at bottom of column
*******************************/

	unsigned char font[96][6] = {
	{0x00,0x00,0x00,0x00,0x00,0x00}, //  
	{0x00,0x5e,0x00,0x00,0x00,0x00}, // !
	{0x00,0x0e,0x0e,0x00,0x00,0x00}, // "
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	{0x00,0x00,0x00,0x00,0x00,0x00}
};


void DrawPixel(unsigned char startx, unsigned char starty, unsigned short color, int lcdNum){
	LCD_SetPage(starty,starty,lcdNum);
	LCD_setColumn(startx,startx,lcdNum);
	write_cmd(0x2c, lcdNum);
	write_dat2(color,lcdNum);
}

void DrawChar(char c, unsigned char x, unsigned char y, int lcdNum, int scale) {
    unsigned char i,j;
		unsigned int k,z;

    // Convert the character to an index
    c = c & 0x7F;
    if (c < ' ') {
        c = 0;
    } else {
        c -= ' ';
    }

    // 'font' is a multidimensional array of [96][char_width]
    // which is really just a 1D array of size 96*char_width.

    // Draw pixels
    for (j=0; j<CHAR_WIDTH*scale; j+=scale) {
        for (i=0; i<CHAR_HEIGHT*scale; i+=scale) {

            if (font[c][j/scale] & (1<<(i/scale))) {
							for(k=0; k<scale; k++){								//scalar factors
								for(z=0; z<scale; z++){
									DrawPixel(x+j+k, y+i+z, white, lcdNum);
								}
							}
            }else{
							for(k=0; k<scale; k++){
								for(z=0; z<scale; z++){
									DrawPixel(x+j+k, y+i+z, black, lcdNum);
								}
							}
						}
				}
		}
}

void DrawString(const char* str, unsigned char x, unsigned char y, int lcdNum, int scale) {
    while (*str) {
        DrawChar(*str++, x, y, lcdNum, scale);
        x += CHAR_WIDTH*scale;
    }
}
